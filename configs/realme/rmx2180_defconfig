## configs/realme/rmx2180_defconfig
```kconfig
CONFIG_APP_CALLER=0x48022780
CONFIG_BOOTLOADER_BASE=0x48000000
CONFIG_BOOTLOADER_SIZE=0x27BBC8
CONFIG_FASTBOOT_FAIL_ADDRESS=0x480264C0
CONFIG_FASTBOOT_INFO_ADDRESS=0x48026464
CONFIG_FASTBOOT_OKAY_ADDRESS=0x4802668C
CONFIG_FASTBOOT_PUBLISH_ADDRESS=0x48026170
CONFIG_FASTBOOT_REGISTER_ADDRESS=0x48026134
CONFIG_LK_LOG_STORE_ADDRESS=0x48042F60
CONFIG_PLATFORM_INIT_ADDRESS=0x48002C80
CONFIG_THREAD_CREATE_ADDRESS=0x48021818
CONFIG_THREAD_RESUME_ADDRESS=0x48021A2C
CONFIG_VIDEO_PRINTF_ADDRESS=0x48031FC8
CONFIG_MTK_DETECT_KEY_ADDRESS=0x48004f4c
CONFIG_APP_ADDRESS=0x48025bec
CONFIG_PLATFORM_INIT_CALLER=0x4802105c
CONFIG_BOOTMODE_ADDRESS=0x4827e9e8
CONFIG_REALME_RMX2180=y
CONFIG_MEDIATEK_MT6765=y
CONFIG_THREAD_SUPPORT=y
CONFIG_STAGE1_SUPPORT=y
CONFIG_LEGACY_LK=n
CONFIG_FREE_ADDRESS=0x48032678
CONFIG_MALLOC_ADDRESS=0x48032ebc
CONFIG_PARTITION_READ_ADDRESS=0x4804b9f0
CONFIG_PARTITION_GET_SIZE_BY_NAME_ADDRESS=0x4804a840
CONFIG_DPRINTF_ADDRESS=0x480322b8
CONFIG_INIT_STORAGE_CALLER=0x48002cb0
CONFIG_INIT_STORAGE_ADDRESS=0x480028e4
CONFIG_FRAMEBUFFER_SUPPORT=y
CONFIG_FRAMEBUFFER_ADDRESS=0x7b890000
CONFIG_FRAMEBUFFER_WIDTH=720
CONFIG_FRAMEBUFFER_HEIGHT=1600
CONFIG_FRAMEBUFFER_BPP=32
CONFIG_FRAMEBUFFER_ALIGNMENT=128
CONFIG_FRAMEBUFFER_LOGO=y
CONFIG_FONT_LOGO=y
CONFIG_LOGO_ADDRESS=0x7a890000
CONFIG_LOGO_TEMPFB_ADDR=0x48b00000
CONFIG_LOGO_DECOMPRESS_ADDR=0x480351e0
CONFIG_DISP_UPDATE_ADDR=0x480010fc
CONFIG_SPOOF_SUPPORT=y
CONFIG_ENVIRONMENT_SUPPORT=y
CONFIG_GET_ENV_ADDRESS=0x4804aaf0
CONFIG_SET_ENV_ADDRESS=0x4804adac
```

## configs/xiaomi/sea_defconfig
```kconfig
CONFIG_APP_ADDRESS=0x4C429254
CONFIG_BOOTLOADER_BASE=0x4C400000
CONFIG_BOOTLOADER_SIZE=0x10CB0C
CONFIG_BOOTMODE_ADDRESS=0x4C50F5A4
CONFIG_DPRINTF_ADDRESS=0x4C43D0CC
CONFIG_ENVIRONMENT_SUPPORT=y
CONFIG_FASTBOOT_FAIL_ADDRESS=0x4C42A074
CONFIG_FASTBOOT_INFO_ADDRESS=0x4C429ED4
CONFIG_FASTBOOT_OKAY_ADDRESS=0x4C42A268
CONFIG_FASTBOOT_PUBLISH_ADDRESS=0x4C429A80
CONFIG_FASTBOOT_REGISTER_ADDRESS=0x4C429A44
CONFIG_FRAMEBUFFER_ADDRESS=0x7bc10000
CONFIG_FRAMEBUFFER_LOGO=y
CONFIG_FONT_LOGO=y
CONFIG_LOGO_ADDRESS=0x7ac10000
CONFIG_LOGO_TEMPFB_ADDR=0x7a210000
CONFIG_LOGO_DECOMPRESS_ADDR=0x4C44027C
CONFIG_DISP_UPDATE_ADDR=0x4C400D4C
CONFIG_FRAMEBUFFER_ALIGNMENT=64
CONFIG_FRAMEBUFFER_BPP=32
CONFIG_FRAMEBUFFER_HEIGHT=2400
CONFIG_FRAMEBUFFER_SUPPORT=y
CONFIG_FRAMEBUFFER_WIDTH=1080
CONFIG_FREE_ADDRESS=0x4C43D4FC
CONFIG_GET_ENV_ADDRESS=0x4C459D80
CONFIG_INIT_STORAGE_ADDRESS=0x4C402684
CONFIG_INIT_STORAGE_CALLER=0x4C4029EA
CONFIG_LK_LOG_STORE_ADDRESS=0x4C45252C
CONFIG_MALLOC_ADDRESS=0x4C43DDD4
CONFIG_MEDIATEK_MT6781=y
CONFIG_MTK_DETECT_KEY_ADDRESS=0x4C404488
CONFIG_PARTITION_GET_SIZE_BY_NAME_ADDRESS=0x4C459A58
CONFIG_PARTITION_READ_ADDRESS=0x4C45B400
CONFIG_PLATFORM_INIT_ADDRESS=0x4C4029BC
CONFIG_PLATFORM_INIT_CALLER=0x4C424808
CONFIG_SET_ENV_ADDRESS=0x4C459F98
CONFIG_STAGE1_SUPPORT=y
CONFIG_THREAD_CREATE_ADDRESS=0x4C424FC4
CONFIG_THREAD_RESUME_ADDRESS=0x4C4251D8
CONFIG_THREAD_SUPPORT=y
CONFIG_VIDEO_PRINTF_ADDRESS=0x4C465DA8
CONFIG_XIAOMI_SEA=y
```
